## arch/powerpc/platforms/wsp/Kconfig
```kconfig
config PPC_WSP
	bool
	select PPC_A2
	select GENERIC_TBSYNC
	select PPC_ICSWX
	select PPC_SCOM
	select PPC_XICS
	select PPC_ICP_NATIVE
	select PCI
	select PPC_IO_WORKAROUNDS if PCI
	select PPC_INDIRECT_PIO if PCI
	select PPC_WSP_COPRO
	default n

menu "WSP platform selection"
	depends on PPC_BOOK3E_64

config PPC_PSR2
	bool "PowerEN System Reference Platform 2"
	select EPAPR_BOOT
	select PPC_WSP
	default y

config PPC_CHROMA
	bool "PowerEN PCIe Chroma Card"
	select EPAPR_BOOT
	select PPC_WSP
	default y

endmenu

config PPC_A2_DD2
	bool "Support for DD2 based A2/WSP systems"
	depends on PPC_A2

config WORKAROUND_ERRATUM_463
	depends on PPC_A2_DD2
	bool "Workaround erratum 463"
	default y

config PPC_WSP_COPRO
	depends on PPC_WSP && PPC_ICSWX
	bool "Support for WSP coprocessors"
	select ANON_INODES
	select PPC_CONTEXT_PROTECTION
	default y

source "arch/powerpc/platforms/wsp/copro/Kconfig"
```

## arch/powerpc/platforms/wsp/copro/Kconfig
```kconfig
config PPC_WSP_COPRO_DEBUGFS
	depends on PPC_WSP_COPRO && DEBUG_FS
	bool "Expose WSP coprocessor information in debugfs"
	default y

config PPC_WSP_COPRO_DEBUG
	depends on PPC_WSP_COPRO_DEBUGFS
	bool "Enable extra debug logging for WSP coprocessors"
	default n

config PPC_WSP_COPRO_GCOV
	depends on GCOV_KERNEL && PPC_WSP_COPRO
	bool "Enable gcov profiling for WSP coprocessors and related code"
	default n

config PPC_WSP_USE_256M_64K_FOR_BOLTED
	depends on PPC_WSP_COPRO
	bool "Use 256M/64K mapping for the kernel linear mapping"
	default n

menu "WSP/PowerEN Coprocessor Unit Selection"
	depends on PPC_WSP_COPRO

config PPC_WSP_UNIT_CDMX
	bool "Crypto Data Mover Accelerator Unit"
	default y

endmenu
```

## drivers/net/poweren/Kconfig
```kconfig
source "drivers/net/poweren/rhea/Kconfig"

source "drivers/net/poweren/khea/Kconfig"

source "drivers/net/poweren/dhea/Kconfig"

source "drivers/net/poweren/mhea/Kconfig"
```

## drivers/net/poweren/dhea/Kconfig
```kconfig
config POWEREN_DHEA
	tristate
	prompt "PowerEN Direct HEA Interface Driver"
	depends on POWEREN_RHEA
	default m
	---help---
	This is a device driver for the PowerEN HEA which allows
	user space programs to configure the PowerEN HEA.

	To compile the driver as a module, choose M here. The module
	will be called dhea.
```

## drivers/net/poweren/khea/Kconfig
```kconfig
config POWEREN_KHEA
	tristate
	prompt "WSP HEA-based Ethernet support"
	depends on POWEREN_RHEA
	select MDIO
	select PHYLIB
	select INET_LRO
	default y
	---help---
	  This driver supports the IBM WSP HEA as a kernel ethernet adapter.

	  To compile the driver as a module, choose M here. The module
	  will be called phea.

menuconfig POWEREN_KHEA_OPTIONS
	bool "KHEA Setup options"
	depends on POWEREN_KHEA
	default y
	---help---
	  Say Y here to get to see options for configuring the WSP KHEA.
	  This option alone does not add any kernel code.

	  If you say N, all options in this submenu will be skipped and disabled.

if POWEREN_KHEA_OPTIONS

config KHEA_ENABLE
	int "Configure which HEA lines are enabled"
	depends on POWEREN_KHEA
	default 4369
	---help---
	 This value specifies which HEA ports should be enabled.
	 Each bit enables one port. The bit numbers should be in X86
	 endianess and computed as: adapter*16 + pport*4 + lport.

config KHEA_BASENAME
       string "Configure the base name for HEA devices"
       depends on POWEREN_KHEA
       default "hea"
       ---help---
         This value specifies the base name of HEA kernel devices
         (default is hea0, hea1, etc..)

config KHEA_NUM_QP
	int "Configure the number of queue pairs"
	depends on POWEREN_KHEA
	default 1
	---help---
	 This value specifies ...

config KHEA_NAPI_WEIGHT
	int "Configure default NAPI weight for HEA interfaces"
	depends on POWEREN_KHEA
	default 256
	---help---
	 This value specifies ...

config KHEA_SENDQ_LEN
	int "Configure the default length of sendq"
	depends on POWEREN_KHEA
	default 1024
	---help---
	 This value specifies the maximum number of packets received
	 in a napi_poll run.

config KHEA_SENDQ_RECLAIM
	int "Configure the default reclaim interval for sendq"
	depends on POWEREN_KHEA
	default 32
	---help---
	 This value specifies how many send WQE enqueue before asking
	 for a completion event.

config KHEA_RECVQ_NUM
	int "Configure the number of receive queue to use"
	depends on POWEREN_KHEA
	default 2
	range 1 2
	---help---
	 This value specifies

config KHEA_RECVQ1_LEN
	int "Configure the default length of receive queue 1"
	depends on POWEREN_KHEA
	default 1024
	---help---
	 This value specifies

config KHEA_RECVQ2_LEN
	int "Configure the default length of receive queue 2"
	depends on POWEREN_KHEA
	default 1024
	---help---
	 This value specifies

config KHEA_RECVQ1_LOW
	int "Configure the queue refill threshold for queue 1"
	depends on POWEREN_KHEA
	default 512
	---help---
	 This value specifies

config KHEA_RECVQ2_LOW
	int "Configure the queue refill threshold for queue 2"
	depends on POWEREN_KHEA
	default 512
	---help---
	 This value specifies

config KHEA_VLAN_ACCELERATION
	bool "KHEA implements VLAN acceleration"
	depends on POWEREN_KHEA
	default n
	---help---
	 Say Y here to tell kHEA to use VLAN acceleration

config KHEA_DO_GSO
	int "KHEA implements GSO acceleration"
	depends on POWEREN_KHEA
	default 1
	---help---
	 Say Y here to tell kHEA to use GSO acceleration

menuconfig POWEREN_KHEA_RECEIVE_OPTIONS
	bool "See kHEA expert tuning options"
	depends on POWEREN_KHEA
	default y
	---help---
	 Say Y here to get to see receiver options for WSP KHEA.
	 This option alone does not add any kernel code.
	 If you say N, all options in this submenu will be skipped and disabled.

if POWEREN_KHEA_RECEIVE_OPTIONS

config KHEA_SEND_LL_LIMIT
	int "Configure the limit to use low latency send (use 0 to disable)"
	depends on POWEREN_KHEA
	default 0
	---help---
	 This value specifies

config KHEA_SEND_WQE_TYPE
	int "Configure the send queue WQE type"
	depends on POWEREN_KHEA
	default 1
	---help---
	 This value specifies

config KHEA_FRAG_ALLOC_ORDER
	int "Configure the page alloc order for fragments"
	depends on POWEREN_KHEA
	default 4
	---help---
	 This value specifies the page alloc order for fragments

config KHEA_RECVQ1_SIZE
	int "Configure the default size for packets in queue 1"
	depends on POWEREN_KHEA
	default 128
	---help---
	 This value specifies the maximum size of packets received in RQ1

config KHEA_RECVQ2_SIZE
	int "Configure the default size for packets in queue 2"
	depends on POWEREN_KHEA
	default 2048
	---help---
	 This value specifies the maximum size of packets received in RQ2

config KHEA_MAX_LRO
	int "Configure the number of LRO sessions (0 to disable - BUGGY)"
	depends on POWEREN_KHEA
	default 0
	---help---
	 This value specifies the number of LRO reassembly sessions

config KHEA_USE_LL_RQ1
	int "Sets RC1 as low latency (use 0 to disable)"
	depends on POWEREN_KHEA
	default 0
	---help---
	 This value specifies if RC1 is low latency or not

endif # POWEREN_KHEA_RECEIVE_OPTIONS

endif # POWEREN_KHEA_OPTIONS
```

## drivers/net/poweren/mhea/Kconfig
```kconfig
config POWEREN_MHEA
	tristate
	prompt "Driver module to map memory on HEA pbic."
	depends on POWEREN_RHEA
	default m
	---help---
	  This is a device driver for the PowerEN HEA which allows
	  user space programs to map memory with the HEA pbic.
```

## drivers/net/poweren/rhea/Kconfig
```kconfig
config POWEREN_RHEA
	tristate
	prompt "PowerEN Raw HEA Low Level Driver"
	depends on POWEREN_HEA
	default y
	---help---
	  This is the platform device driver for the PowerEN HEA. All
	  other device drives, which want to allocate a resource from
	  the HEA have to use the rhea interface to get access to it.

	  To compile the driver as a module, choose M here. The module
	  will be called rhea.

menuconfig POWEREN_RHEA_OPTIONS
	bool "RHEA Setup options"
	depends on POWEREN_RHEA
	default y
	---help---
	  Say Y here to get to see options for configuring the WSP KHEA.
	  This option alone does not add any kernel code.

	  If you say N, all options in this submenu will be skipped and disabled.

if POWEREN_RHEA_OPTIONS

config POWEREN_RHEA_TIMER_MS
	int "Configure how much time should be put between two timers"
	depends on POWEREN_RHEA
	default 900
	---help---
	  This values specifies the amount of time in ms
	  between two different timer calls,
	  which checks the link state of
	  the 1G interface.

endif # POWEREN_RHEA_OPTIONS
```

## drivers/pixad/Kconfig
```kconfig
#
# PowerEN PiXAD DRIVER
#

config POWEREN_PIXAD
	depends on PPC_WSP_UNIT_XMLX
	tristate "Wire-Speed Processor XML PiXAD driver"
	default m
	select MMU_NOTIFIER
	---help---
	  Enable the WSP PiXAD(PowerEN Xml Accelerator Driver)
	  driver for the XML coprocessor

config POWEREN_PIXAD_DEBUG
	bool "Wire-Speed Processor XML PiXAD driver Debugging"
	depends on POWEREN_PIXAD
```

## drivers/poweren/Kconfig
```kconfig
source "drivers/poweren/pcie_endpoint/Kconfig"

source "drivers/poweren/veth/Kconfig"
```

## drivers/poweren/pcie_endpoint/Kconfig
```kconfig
#
# PowerEN Processor PCI Express Endpoint Device Driver
#

config POWEREN_EP_DEVICE
	bool "PowerEN Processor Endpoint Platform Driver"
	default n
	help
          This is the implementation of a platform driver for
          the PowerEN Processor Endpoint. It is intended to allow
          drivers that needs PCIe resources to register against it
          and ask for them. It also provides a component named
          "slot manager" that allocates and configures two 1MB buffers
          per function for inbound and outbound mmio transfers.
          The manager split the buffers in slots for multi-process and
          multi-thread usage

config POWEREN_EP_HOST
	tristate "PowerEN Processor Endpoint Host PCIe Driver"
	depends on PCI
	default n
	help
          This is the implementation of a PCI Express driver for
          the PowerEN Processor Endpoint. It is intended to allow
          drivers that needs PCIe resources to register against it
          and ask for them. It also provides a component named
          "slot manager", see description on POWEREN_EP_DEVICE.
          It also has an iommu address space manager.
          Enable this if building a kernel for a machine with the
          endpoint plugged into its PCI bus.

config POWEREN_EP_HP_DEVICE
	tristate "Device PowerEN Processor Endpoint High Performance Driver"
	depends on POWEREN_EP_DEVICE
	default n
	help
          This is the implementation of a char device that enables
          host and device to exchange data using MMIO and DMA
          transfers. It also has a memory registration component
          that allow to reserve DMA windows for multi-process and
          multi-thread usage. Enable this if building a kernel for
          the device.

config POWEREN_EP_HP_HOST
	tristate "Host PowerEN Processor Endpoint High Performance Driver"
	depends on POWEREN_EP_HOST
	default n
	help
          See description on POWEREN_EP_HP_DEVICE. It also allows user
          applications to map memory buffers allocated in userspace
          against the host iommu. Enable this if building
          a kernel for the host.

menuconfig POWEREN_EP_DEBUG
	bool "POWEREN EP Extra Debug Output"
	depends on POWEREN_EP_DEVICE || POWEREN_EP_HOST
	default n
```

## drivers/poweren/veth/Kconfig
```kconfig
config POWEREN_VIRTIO_VETH
	default m
	tristate "PowerEN Virtual Ethernet driver"
	depends on VIRTIO_NET && (POWEREN_EP_DEVICE || POWEREN_EP_HOST)
	---help---
	  A virtio-based virtual network driver, used to facilitate
	  cross-PCIe communication between the host machine and the OS
	  running on an IBM PowerEN card.
```
